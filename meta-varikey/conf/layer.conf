## meta-varikey/conf/layer.conf
```bitbake
# SPDX-FileCopyrightText: 2026 Roman Koch
# SPDX-License-Identifier: MIT

BBPATH .= ":${LAYERDIR}"
BBFILES += "${LAYERDIR}/recipes-*/*/*.bb"
BBFILE_COLLECTIONS += "varikey"
BBFILE_PATTERN_varikey = "^${LAYERDIR}/"
BBFILE_PRIORITY_varikey = "6"
LAYERDEPENDS_varikey = "core"
LAYERSERIES_COMPAT_varikey = "scarthgap"
```
